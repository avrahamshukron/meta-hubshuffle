## conf/distro/openmentos.conf
```bitbake
MAINTAINER = "Avi Shukron <avraham.shukron@gmail.com>"

# Base this distro on poky
require conf/distro/poky.conf

DISTRO = "openmentos"
DISTRO_NAME = "OpenMentOS - The Open Media & Entertainment System"
DISTRO_VERSION = "1.0"
DISTRO_CODENAME = "openmentos"
SDK_VENDOR = "-openmentossdk"
SDK_VERSION := "${@'${DISTRO_VERSION}'.replace('snapshot-${DATE}', 'snapshot')}"

# Whitelist commercial license. This is needed because of omxplayer and possible others.
LICENSE_FLAGS_WHITELIST += "commercial"

# Use systemd
INIT_MANAGER ?= "systemd"
# systemd isn't suitable with musl
INIT_MANAGER_libc-musl ?= "sysvinit"

DISTRO_FEATURES += "systemd ext2 usbhost usbgadget wifi opengl pam pulseaudio egl bluetooth nfs"

PREFERRED_PROVIDER_jpeg = "libjpeg-turbo"
PREFERRED_PROVIDER_jpeg-native = "libjpeg-turbo-native"

# Set hostname
hostname_pn-base-files = "openmentos"

# Set locale
GLIBC_GENERATE_LOCALES = "en_GB.UTF-8 en_US.UTF-8"
IMAGE_LINGUAS = "en-gb en-us"

# Set default timezone
DEFAULT_TIMEZONE = "Asia/Jerusalem"
```

## conf/layer.conf
```bitbake
# We have a conf and classes directory, add to BBPATH
BBPATH .= ":${LAYERDIR}"

# We have recipes-* directories, add to BBFILES
BBFILES += "${LAYERDIR}/recipes-*/*/*.bb \
            ${LAYERDIR}/recipes-*/*/*.bbappend"

BBFILE_COLLECTIONS += "meta-openmentos-layer"
BBFILE_PATTERN_meta-openmentos-layer = "^${LAYERDIR}/"
BBFILE_PRIORITY_meta-openmentos-layer = "10"

LAYERDEPENDS_meta-openmentos-layer = "core"
LAYERDEPENDS_meta-openmentos-layer += "raspberrypi meta-rpi meta-kodi"
LAYERSERIES_COMPAT_meta-openmentos-layer = "dunfell"
```

## conf/local.conf.sample
```bitbake
# Sample Local configuration for openmentos images
# Yocto Project 3.1 Poky distribution [dunfell] branch

DISTRO = "openmentos"
MACHINE = "raspberrypi3-custom"

# Choose the board you are building for
#MACHINE = "raspberrypi"
#MACHINE = "raspberrypi0"
#MACHINE = "raspberrypi0-wifi"
#MACHINE = "raspberrypi2"
#MACHINE = "raspberrypi3"
#MACHINE = "raspberrypi4"
#MACHINE = "raspberrypi-cm"
#MACHINE = "raspberrypi-cm3"

#
# Where to place downloads
#
# During a first build the system will download many different source code tarballs
# from various upstream projects. This can take a while, particularly if your network
# connection is slow. These are all stored in DL_DIR. When wiping and rebuilding you
# can preserve this directory to speed up this part of subsequent builds. This directory
# is safe to share between multiple builds on the same machine too.
#
# The default is a downloads directory under TOPDIR which is the build directory.
#
#DL_DIR ?= "${TOPDIR}/downloads"

#
# Where to place shared-state files
#
# BitBake has the capability to accelerate builds based on previously built output.
# This is done using "shared state" files which can be thought of as cache objects
# and this option determines where those files are placed.
#
# You can wipe out TMPDIR leaving this directory intact and the build would regenerate
# from these files if no changes were made to the configuration. If changes were made
# to the configuration, only shared state files where the state was still valid would
# be used (done using checksums).
#
# The default is a sstate-cache directory under TOPDIR.
#
#SSTATE_DIR ?= "${TOPDIR}/sstate-cache"

#
# Where to place the build output
#
# This option specifies where the bulk of the building work should be done and
# where BitBake should place its temporary files and output. Keep in mind that
# this includes the extraction and compilation of many applications and the toolchain
# which can use Gigabytes of hard disk space.
#
# The default is a tmp directory under TOPDIR.
#
#TMPDIR = "${TOPDIR}/tmp"

PACKAGE_CLASSES = "package_ipk"

# For a root passwd, change 'openmentos' below to your password
INHERIT += "extrausers"
EXTRA_USERS_PARAMS = "usermod -P openmentos root; "

# Force root to change password on first login
#INHERIT += "chageusers"
#CHAGE_USERS_PARAMS = "chage -d0 root; "

USER_CLASSES = "image-mklibs image-prelink"
RM_OLD_IMAGE = "1"
INHERIT += "rm_work"
CONF_VERSION = "1"
```
